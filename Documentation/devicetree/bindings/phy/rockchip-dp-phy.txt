## Documentation/devicetree/bindings/phy/rockchip-dp-phy.txt
```
Rockchip Soc Seroes Display Port PHY
------------------------------------

Required properties:
- compatible : should be one of the following supported values:
	 - "rockchip.rk3288-dp-phy"

- reg : a list of registers used by phy driver
- clocks: from common clock binding: handle to dp clock.
	of memory mapped region.
- clock-names: from common clock binding:
	Required elements: "sclk_dp" "sclk_dp_24m"

- rockchip,grf: this soc should set GRF regs, so need get grf here.
- #phy-cells : from the generic PHY bindings, must be 0;

Example:

edp_phy: phy@ff770274 {
	compatilble = "rockchip,rk3288-dp-phy";
	reg = <0xff770274 4>;
	rockchip,grf = <&grf>;
	clocks = <&cru SCLK_EDP_24M>;
	clock-names = "24m";
	#phy-cells = <0>;
}
```

## Documentation/devicetree/bindings/video/analogix_dp-rockchip.txt
```
Rockchip RK3288 specific extensions to the Analogix Display Port
================================

Required properties:
- compatible: "rockchip,rk3288-edp";

- reg: physical base address of the controller and length

- clocks: from common clock binding: handle to dp clock.
	  of memory mapped region.

- clock-names: from common clock binding:
	       Required elements: "dp" "pclk"

- resets: Must contain an entry for each entry in reset-names.
	  See ../reset/reset.txt for details.

- reset-names: Must include the name "dp"

- rockchip,grf: this soc should set GRF regs, so need get grf here.

- ports: contain a port node with endpoint definitions as defined in
  Documentation/devicetree/bindings/media/video-interfaces.txt.


For the below properties, please refer to Analogix DP binding document:
 * Documentation/devicetree/bindings/drm/bridge/analogix_dp.txt
- phys (required)
- phy-names (required)
- hpd-gpios (optional)
- analogix,need-force-hpd (optional)
-------------------------------------------------------------------------------

Example:
	dp-controller: dp@ff970000 {
		compatible = "rockchip,rk3288-dp";
		reg = <0xff970000 0x4000>;
		interrupts = <GIC_SPI 98 IRQ_TYPE_LEVEL_HIGH>;
		clocks = <&cru SCLK_EDP>, <&cru PCLK_EDP_CTRL>;
		clock-names = "dp", "pclk";
		phys = <&dp_phy>;
		phy-names = "dp";

		rockchip,grf = <&grf>;
		resets = <&cru 111>;
		reset-names = "dp";

		status = "disabled";

		ports {
			edp_in: port {
				#address-cells = <1>;
				#size-cells = <0>;
				edp_in_vopb: endpoint@0 {
					reg = <0>;
					remote-endpoint = <&vopb_out_edp>;
				};
				edp_in_vopl: endpoint@1 {
					reg = <1>;
					remote-endpoint = <&vopl_out_edp>;
				};
			};

			edp_out: port@1 {
				reg = <1>;
				#address-cells = <1>;
				#size-cells = <0>;
				edp_out_panel: endpoint {
					reg = <0>;
					remote-endpoint = <&panel_in_edp>
				};
			};
		};
	};
```
